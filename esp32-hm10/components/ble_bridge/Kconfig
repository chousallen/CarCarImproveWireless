## esp32-hm10/components/ble_bridge/Kconfig
```kconfig
menu "BLE Bridge Configuration"

    config BLE_BRIDGE_LOG_LEVEL
        int "BLE Bridge Log Level"
        default 3
        range 0 5
        help
            Set the log level for BLE bridge module.
            0: None, 1: Error, 2: Warning, 3: Info, 4: Debug, 5: Verbose

    config BLE_BRIDGE_MAX_DATA_LEN
        int "Maximum data length"
        default 512
        range 128 2048
        help
            Maximum length of data that can be sent/received in a single transaction.

endmenu
```
